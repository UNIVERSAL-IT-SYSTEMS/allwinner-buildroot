## package/mali-3d-r2p4/Config.in
```kconfig
config BR2_PACKAGE_MALI_3D_R2P4
       bool "mali 3d(r2p4)"
       help
         Mali 3d
```

## package/sunxi-tools/Config.in
```kconfig
config BR2_PACKAGE_SUNXI_TOOLS
       bool "sunxi tools"
       help
         sunxi-tools from open community
```
